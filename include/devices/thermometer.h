#pragma once

#include <Arduino.h>
#include "pins.h"

#define Vcc 3.300
#define Vdd 5.000
#define R_G 10000

//传感器电阻在25摄氏度的时候约为10.0k
//对地接了一个10k的分压电阻
//顶上接得是5V
//设传感器电阻为R_T,分压电阻为R_G
//那么分压 U = R_G / (R_T + R_G) * 5V
// Vcc为标准电压,模拟值ana = U / Vcc * 1024
//那么 ana = R_G / (R_T + R_G) * 5V / Vcc * 1024
//那么 ana = 1024 * 5V * R_G / ((R_T + R_G) * Vcc)
//那么 (R_T + R_G) * Vcc * ana = 1024 * 5V * R_G
//那么 R_T + R_G = 1024 * 5V * R_G / (Vcc * ana)
//那么 R_T = 1024 * 5V * R_G / (Vcc * ana) - R_G
int getR_T() {
    //先读出模拟值
    int ana = analogRead(P_TEMP);
    int R_T = 1024 * Vdd * R_G / (Vcc * ana) - R_G;
    return R_T;
}

//打一组表,从-20度到50度
const int R[80] = {
    100000,
    /*-20 ~ -11*/
    69931,
    66329,
    63148,
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    45174,
    /*-10 ~ -1*/
    43117,
    41166,
    39315,
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    28773,
    /*0 ~ 9*/
    27494,
    26324,
    25212,
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    18771,
    /*10 ~ 19*/
    18015,
    17294,
    16605,
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    12577,
    /*20 ~ 29*/
    12098,
    11641,
    11203,
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    8619,
    /*30 ~ 39*/
    8309,
    8012,
    7727,
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    6030,
    /*40 ~ 49*/
    5825,
    5627,
    5438,
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    0,
};

float getT_C() {
    int   r = getR_T();
    float t;
    for (int i = 0; i <= 70; i++) {
        if (R[i] >= r && r >= R[i + 1]) {
            if (i >= 20) {
                t = -20.0 + float(i) + 1.0 - (float(r - R[i + 1]) / float(R[i] - R[i + 1]));
            } else {
                t = -20.0 + float(i) + (float(r - R[i + 1]) / float(R[i] - R[i + 1]));
            }
            return t;
        }
    }
    return 0.0;
}

float getT_F() {
    return 32.0 + getT_C() * 1.8;
}

float getT_K() {
    return 273.15 + getT_C();
}